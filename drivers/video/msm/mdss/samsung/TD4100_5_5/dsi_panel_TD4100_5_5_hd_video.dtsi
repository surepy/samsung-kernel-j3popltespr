/* Copyright (c) 2013-14, Samsung Electronics Corporation. All rights reserved.
 *
 * This program is free software; you can redistribute it and/or modify
 * it under the terms of the GNU General Public License version 2 and
 * only version 2 as published by the Free Software Foundation.
 *
 * This program is distributed in the hope that it will be useful,
 * but WITHOUT ANY WARRANTY; without even the implied warranty of
 * MERCHANTABILITY or FITNESS FOR A PARTICULAR PURPOSE.  See the
 * GNU General Public License for more details.
 */

/*---------------------------------------------------------------------------
 * This file is autogenerated file using gcdb parser. Please do not edit it.
 * Update input XML file to add a new entry or update variable in this file
 * VERSION = "1.0"
 *---------------------------------------------------------------------------*/
&mdss_mdp {
	ss_dsi_panel_TD4100_5_5_HD: ss_dsi_panel_TD4100_5_5_HD {
		qcom,mdss-dsi-panel-name = "ss_dsi_panel_TD4100_5_5_HD";
		qcom,mdss-dsi-panel-controller = <&mdss_dsi0>;
		qcom,mdss-dsi-panel-width = <720>;
		qcom,mdss-dsi-panel-height = <1280>;
		qcom,mdss-dsi-bpp = <24>;
		qcom,mdss-dsi-panel-destination = "display_1";
		qcom,mdss-dsi-panel-timings = [B9 2A 1C 00 54 58 22 2E 23 03 04 00];
		qcom,mdss-dsi-panel-timings-8996 = [	/* MSM8953 */
			21 1E 06 07 04 03 04 a0				/* Data 0 */
			21 1E 06 07 04 03 04 a0				/* Data 1 */
			21 1E 06 07 04 03 04 a0				/* Data 2 */
			21 1E 06 07 04 03 04 a0				/* Data 3 */
			21 15 06 07 04 03 04 a0				/* Clk lane */
		];
		qcom,mdss-dsi-on-command = [
			/* Initializing Sequence(1)*/
			39 01 00 00 00 00 02 B0 04			/* Manufacturer command access project */
			39 00 00 00 00 00 04 B3 10 00 06 	/* Interface setting */
			39 00 00 00 00 00 08 B6				/* DSI control */
				32 43 80 00 00 07 86
			39 00 00 00 00 00 07 BA				/* Backlight control 3 */
				07 87 3A 0A 2D 88
			39 00 00 00 00 00 04 BB 00 B4 A0	/* Sunlight readability enhancement */
			39 00 00 00 00 00 04 BC 00 B4 A0	/* Sunlight readbility enhancement */
			39 00 00 00 00 00 04 BD 00 B4 A0	/* Sunlight readbility enhancement */
			39 00 00 00 00 00 02 BE 04			/* External clock setting */
			39 00 00 00 00 00 12 C0				/* Display setting 4 */
				00 00 00 00
				00 00 00 00
				00 00 00 00
				00 00 00 00
				00
			39 00 00 00 00 00 23 C1				/* Display setting 1 */
				04 48 01 00
				33 08 11 00
				11 00 73 23
				23 11 00 00
				00 00 00 00
				00 00 00 00
				00 00 DF 00
				30 00 01 00
				00 00
			39 00 00 00 00 00 14 C2				/* Display setting 2 */
				00 F0 05 00
				0A 04 08 00
				24 19 00 00
				00 00 00 00
				00 01 00
			39 00 00 00 00 00 40 C3				/* Display setting 3 */
				51 15 11 51
				10 00 00 00
				00 00 00 00
				00 00 00 00
				00 00 00 00
				01 01 03 28
				00 01 01 01
				00 00 00 00
				00 00 00 00
				00 00 00 00
				00 00 00 00
				00 00 00 00
				67 01 00 00
				00 00 67 01
				00 00 00 00
				40 20 01
			39 00 00 00 00 00 29 C4				/* Source timing setting and SOUT equalize setting */
				70 01 00 00
				00 00 00 00
				00 00 00 00
				00 00 00 00
				00 00 00 00
				00 00 00 00
				00 00 00 00
				00 00 00 00
				00 00 00 00
				00 00 01 01

			/* Initializing Sequence(2)*/
			39 00 00 00 00 00 0B C5				/* Crosshair */
				08 00 00 00
				00 70 00 00
				2D 41
			39 00 00 00 00 00 22 C6				/* Panel timing setting */
				C2 14 89 00
				00 14 89 00
				00 00 00 00
				00 00 00 00
				00 00 00 00
				00 00 00 00
				00 00 00 00
				00 00 00 C2
				C2
			39 00 00 00 00 00 2F C7				/* Gamma setting common set */
				00 0D 17 25
				32 3C 55 68
				77 85 39 45
				52 67 72 7F
				8F 9B B0 00
				0D 17 25 32
				3C 55 68 77
				85 39 45 54
				67 72 7F 8F
				9B B0 00 97
				00 97 00 97
				00 97
			39 00 00 00 00 00 38 C8				/* Digital gamma setting 1 */
				01 00 00 00
				00 FC 00 00
				00 00 00 BE
				00 00 00 00
				00 F7 00 00
				00 00 00 FC
				00 00 00 00
				00 C5 00 00
				00 00 00 F8
				00 00 00 00
				00 FC 00 00
				00 00 00 C0
				00 00 00 00
				00 F7 00
			39 00 00 00 00 00 14 C9				/* Digital gamma setting 2 */
				00 00 00 00
				00 FC 00 00
				00 00 00 FC
				00 00 00 00
				00 FC 00
			39 00 00 00 00 00 2C CA				/* Color enhancement */
				1D FA FC FA
				00 E6 E1 A5
				00 DB B1 DC
				00 CD 00 05
				F7 E5 00 00
				07 F3 00 00
				00 00 00 00
				00 00 00 00
				00 00 00 00
				00 00 00 00
				00 00 00
			39 00 00 00 00 00 2E CC				/* Panel interface control */
				00 00 00 00
				D2 72 12 16
				1A 1E D0 70
				42 46 00 00
				00 00 00 00
				00 00 00 00
				00 00 00 00
				00 00 44 40
				70 D0 1C 18
				14 10 72 D2
				00 00 00 00
				00
			/* Initializing Sequence(3)*/
			39 00 00 00 00 00 14 CD				/* Touch control */
				03 06 69 01
				00 00 00 00
				00 00 00 00
				00 00 00 00
				01 00 00
			39 00 00 00 00 00 19 CE				/* Backlight control 4 */
				7D 40 48 56
				67 78 88 98
				A7 B5 C3 D1
				DE E9 F2 FA
				FF 04 00 04
				04 45 00 00
			39 00 00 00 00 00 03 CF 48 10		/* Panel synchronous output */
			39 00 00 00 00 00 13 D0				/* Power setting for CHGP */
				11 04 59 D9
				03 10 10 40
				19 08 99 00
				00 00 00 00
				00 00
			39 00 00 00 00 00 02 D1 04			/* Touch period and source drive mode select */
			39 00 00 00 00 00 1C D3				/* Power setting for internal power */
				BB 3B 33 3B
				44 3B 44 3B
				00 00 EC 9B
				8B 23 22 B3
				B3 3B BB 4F
				D0 3C 10 12
				10 00 10
			39 00 00 00 00 00 19 D4				/* Temperature sensor */
				80 04 04 33
				00 04 00 00
				00 00 00 00
				00 00 00 00
				00 00 0A 90
				05 00 64 94
			39 00 00 00 00 00 02 D6 41			/* Sequencer test control */

			39 00 00 00 00 00 25 D7				/* Timing control for power on sequencer test mode */
				F6 FF 03 05
				43 24 80 1F
				C7 1F 1B 00
				0F 01 20 08
				80 3F 00 78
				00 40 24 15
				00 33 02 C0
				AF CB 60 30
				FC 00 3F 00
			39 00 00 00 00 00 09 D8				/* Temperature sensor read */
				00 00 00 00
				00 00 00 00
			39 00 00 00 00 00 05 DD				/* Outline sharpening control */
				30 06 23 65

			/* CABC Mode control Function */
			39 00 00 00 00 00 02 53 04	//Slope dimming OFF
			39 01 00 00 00 00 02 55 00

			/* Display on Sequence(4) */
			05 01 00 00 00 00 02 11 00
		];
		qcom,mdss-dsi-off-command = [
			05 01 00 00 00 00 02 28 00	/* no wait */
			05 01 00 00 50 00 02 10 00	/* wait 80ms(0x50) */
		];
		//qcom,mdss-dsi-post-panel-on-command = ;

		//qcom,cmd-sync-wait-broadcast = ;
		//qcom,mdss-dsi-fbc-enable = ;
		//qcom,mdss-dsi-fbc-slice-height = ;
		//qcom,mdss-dsi-fbc-2d-pred-mode = ;
		//qcom,mdss-dsi-fbc-ver2-mode = ;
		//qcom,mdss-dsi-fbc-bpp = ;
		//qcom,mdss-dsi-fbc-packing = ;
		//qcom,mdss-dsi-fbc-quant-error = ;
		//qcom,mdss-dsi-fbc-bias = ;
		//qcom,mdss-dsi-fbc-pat-mode = ;
		//qcom,mdss-dsi-fbc-vlc-mode = ;
		//qcom,mdss-dsi-fbc-bflc-mode = ;
		//qcom,mdss-dsi-fbc-h-line-budget = ;
		//qcom,mdss-dsi-fbc-budget-ctrl = ;
		//qcom,mdss-dsi-fbc-block-budget = ;
		//qcom,mdss-dsi-fbc-lossless-threshold = ;
		//qcom,mdss-dsi-fbc-lossy-threshold = ;
		//qcom,mdss-dsi-fbc-rgb-threshold = ;
		//qcom,mdss-dsi-fbc-lossy-mode-idx = ;
		//qcom,mdss-dsi-fbc-max-pred-err = ;
		qcom,mdss-dsi-h-back-porch = <158>;
		qcom,mdss-dsi-h-front-porch = <252>;
		qcom,mdss-dsi-h-pulse-width = <4>;
		qcom,mdss-dsi-h-sync-skew = <0>;
		qcom,mdss-dsi-v-back-porch = <125>;
		qcom,mdss-dsi-v-front-porch = <127>;
		qcom,mdss-dsi-v-pulse-width = <127>;
		qcom,mdss-dsi-h-left-border = <0>;
		qcom,mdss-dsi-h-right-border = <0>;
		qcom,mdss-dsi-v-top-border = <0>;
		qcom,mdss-dsi-v-bottom-border = <0>;
		qcom,mdss-dsi-underflow-color = <0xff>;
		qcom,mdss-dsi-border-color = <0>;
		//qcom,mdss-dsi-pan-enable-dynamic-fps = ;
		//qcom,mdss-dsi-pan-fps-update = ;
		//qcom,min-refresh-rate = ;
		//qcom,max-refresh-rate = ;
		qcom,mdss-dsi-bl-pmic-control-type = "bl_ctrl_dcs";
		//qcom,mdss-dsi-bl-pwm-pmi = ;
		//qcom,mdss-dsi-bl-pmic-bank-select = ;
		//qcom,mdss-dsi-bl-pmic-pwm-frequency = ;
		//qcom,mdss-dsi-pwm-gpio = ;
		qcom,mdss-dsi-bl-min-level = <1>;
		qcom,mdss-dsi-bl-max-level = <256>;
		qcom,mdss-brightness-max-level = <256>;
		//qcom,mdss-dsi-interleave-mode = ;
		qcom,mdss-dsi-panel-type = "dsi_video_mode";
		//qcom,5v-boost-gpio = ;
		//qcom,mdss-dsi-te-check-enable = ;
		//qcom,mdss-dsi-te-using-te-pin = ;
		//qcom,mdss-dsi-te-pin-select = ;
		//qcom,mdss-dsi-te-dcs-command = ;
		//qcom,mdss-dsi-wr-mem-start = ;
		//qcom,mdss-dsi-wr-mem-continue = ;
		qcom,mdss-dsi-h-sync-pulse = <0>;
		qcom,mdss-dsi-hfp-power-mode;
		//qcom,mdss-dsi-hbp-power-mode;
		//qcom,mdss-dsi-hsa-power-mode;
		//qcom,mdss-dsi-last-line-interleave = ;
		qcom,mdss-dsi-bllp-eof-power-mode;
		qcom,mdss-dsi-bllp-power-mode;
		qcom,mdss-dsi-traffic-mode = "burst_mode";
		qcom,mdss-dsi-pixel-packing = "loose";
		qcom,mdss-dsi-virtual-channel-id = <0>;
		qcom,mdss-dsi-color-order = <0>;
		qcom,mdss-dsi-lane-0-state;
		qcom,mdss-dsi-lane-1-state;
		qcom,mdss-dsi-lane-2-state;
		qcom,mdss-dsi-lane-3-state;
		qcom,mdss-dsi-t-clk-post = <0x0C>;
		qcom,mdss-dsi-t-clk-pre = <0x28>;
		qcom,mdss-dsi-stream = <0>;
		qcom,mdss-dsi-mdp-trigger = "none";
		qcom,mdss-dsi-dma-trigger = "trigger_sw";
		qcom,mdss-dsi-panel-framerate = <60>;
		//qcom,mdss-dsi-panel-clockrate = <510000000>;
		//qcom,mdss-mdp-transfer-time-us = ;
		qcom,mdss-dsi-on-command-state = "dsi_lp_mode"; /* TD4100 : CLK & DATA should be LP11 for 80ms after reset. So we send init_cmds before TG enable */
		qcom,mdss-dsi-off-command-state = "dsi_hs_mode";
		//qcom,mdss-dsi-post-mode-switch-on-command-state = ;
		qcom,mdss-pan-physical-width-dimension = <69>;
		qcom,mdss-pan-physical-height-dimension = <122>;
		//qcom,mdss-dsi-panel-mode-gpio-state = ;
		//qcom,mdss-tear-check-disable = ;
		//qcom,mdss-tear-check-sync-cfg-height = ;
		//qcom,mdss-tear-check-sync-init-val = ;
		//qcom,mdss-tear-check-sync-threshold-start = ;
		//qcom,mdss-tear-check-sync-threshold-continue = ;
		//qcom,mdss-tear-check-start-pos = ;
		//qcom,mdss-tear-check-rd-ptr-trigger-intr = ;
		//qcom,mdss-tear-check-frame-rate = ;
		qcom,mdss-dsi-reset-sequence = <0 1>, <1 1>;
		//qcom,partial-update-enabled = ;
		//qcom,mdss-dsi-horizontal-line-idle = ;
		//qcom,partial-update-roi-merge = ;
		//qcom,dcs-cmd-by-left = ;
		qcom,mdss-dsi-lp11-init;
		qcom,mdss-dsi-init-delay-us = <100>;
		qcom,mdss-dsi-rx-eot-ignore;
		qcom,mdss-dsi-tx-eot-append;
		//qcom,ulps-enabled = ;
		//qcom,suspend-ulps-enabled = ;
		//qcom,panel-roi-alignment = ;
		//qcom,esd-check-enabled;
		//qcom,mdss-dsi-panel-status-command = ;
		//qcom,mdss-dsi-panel-status-command-mode = ;
		//qcom,mdss-dsi-panel-status-check-mode= ;
		//qcom,mdss-dsi-panel-status-read-length = ;
		//qcom,mdss-dsi-panel-status-valid-params = ;
		//qcom,mdss-dsi-panel-status-value = ;
		//qcom,mdss-dsi-panel-max-error-count = ;
		//qcom,dynamic-mode-switch-enabled = ;
		//qcom,dynamic-mode-switch-type = ;
		//qcom,mdss-dsi-post-mode-switch-on-command = ;
		//qcom,video-to-cmd-mode-switch-commands = ;
		//qcom,cmd-to-video-mode-switch-commands = ;
		//qcom,mdss-dsi-panel-orientation = ;
		//qcom,panel-ack-disabled = ;
		//qcom,mdss-dsi-force-clock-lane-hs; /* TD4100 : CLK & DATA should be LP11 for 80ms after reset.  samsung,dsi_force_clock_lane_hs is enabled*/
		//qcom,compression-mode = ;
		//qcom,panel-supply-entries = ;
		//qcom,config-select = ;
		//qcom,lm-split = ;
		//qcom,split-mode = ;
		//qcom,mdss-dsc-encoders = ;
		//qcom,mdss-dsc-slice-height = ;
		//qcom,mdss-dsc-slice-width = ;
		//qcom,mdss-dsc-slice-per-pkt = ;
		//qcom,mdss-dsc-bit-per-component = ;
		//qcom,mdss-dsc-bit-per-pixel = ;
		//qcom,mdss-dsc-block-prediction-enable = ;
		//qcom,mdss-dsc-config-by-manufacture-cmd = ;
		//qcom,dba-panel = ;
		//qcom,bridge-name = ;
		//qcom,adjust-timer-wakeup-ms = ;
		//qcom,mdss-dsi-display-timings = ;
		//qcom,mdss-dsi-timing-default = ;
		//qcom,mdss-dsi-timing-switch-command = ;
		//qcom,mdss-dsi-timing-switch-command-state  = ;

/*
 * ************************************************************************************************************************************
 *
 *
 *			Below  parameters are samsung dependent thigs
 *
 *
 * ************************************************************************************************************************************
 */
 		samsung,panel-vendor = "BOE";
		samsung,tft-common-support;
		samsung,enter_hbm_lux = <20000>;
		samsung,support_mdnie_lite;
		samsung,dsi_force_clock_lane_hs;  /* TD4100 : CLK & DATA should be LP11 for 80ms after reset. */

		/* To use device_resume & device_suspend for optimizing display on time */
		samsung,reduce_display_on_time;
		samsung,wait_after_reset_delay = <80>; /* Flash loading time */
		samsung,wait_after_sleep_out_delay = <90>; /* More than 5frame 16.6 * 5 = 83ms+margin 7ms*/

		samsung,level1_key_enable_tx_cmds_revA = [
			39 01 00 00 00 00 02 B0 04
		];
		samsung,level1_key_disable_tx_cmds_revA = [
			39 01 00 00 00 00 02 B0 04
		];

		samsung,packet_size_tx_cmds_revA = [
			37 01 00 00 00 00 02 07 00
		];

		samsung,display_on_tx_cmds_revA = [
			05 01 00 00 00 00 02 29 00
		];

		samsung,display_off_tx_cmds_revA = [05 01 00 00 00 00 02 28 00];

		/*
		 * First parameters can be changed
		 * by function of samsung_nv_read()
		 * because of that means offset of
		 * read position
		 */
		samsung,reg_read_pos_tx_cmds_revA = [
			15 01 00 00 00 00 02 B0 00
		];
		samsung,manufacture_id0_rx_cmds_revA = [06 01 00 00 00 00 01 da 01 00];
		samsung,manufacture_id1_rx_cmds_revA = [06 01 00 00 00 00 01 db 01 00];
		samsung,manufacture_id2_rx_cmds_revA = [06 01 00 00 00 00 01 dc 01 00];

		samsung,tft_pwm_tx_cmds_revA=[
			39 00 00 00 00 00 02 51 FF/*First command should be PWM duty change command */
			39 01 00 00 00 00 02 53 0C //Slope dimming ON
		];
		samsung,cabc_on_tx_cmds_revA = [
			39 01 00 00 00 00 02 55 01
		];
		samsung,cabc_off_tx_cmds_revA = [
			39 01 00 00 00 00 02 55 00
		];
		/*
		* ************************************************************************************************************************
		* Scaled level to index mappings
		* ************************************************************************************************************************
		*/
		samsung,candela_map_table_revA = <
		/*<idx>	  <from>  <till> <scaled_level> */
			0	0	1	0
			1	2	2	2
			2	3	3	3
			3	4	5	5	/* MIN 5 cd */
			4	6	6	10
			5	7	7	12
			6	8	8	15
			7	9	9	17
			8	10	11	20	/* DIM 20 cd*/
			9	12	13	22
			10	14	14	25
			11	15	16	28
			12	17	18	30
			13	19	19	32
			14	20	21	34
			15	22	22	37
			16	23	24	38
			17	25	26	41
			18	27	27	44
			19	28	29	45
			20	30	31	48
			21	32	32	51
			22	33	34	53
			23	35	35	56
			24	36	37	57
			25	38	39	60
			26	40	40	63
			27	41	42	64
			28	43	43	67
			29	44	45	68
			30	46	47	71
			31	48	48	74
			32	49	50	77
			33	51	52	79
			34	53	53	81
			35	54	55	83
			36	56	56	86
			37	57	58	87
			38	59	60	90
			39	61	61	93
			40	62	63	94
			41	64	64	97
			42	65	66	99
			43	67	68	102
			44	69	69	105
			45	70	71	106
			46	72	76	109
			47	74	74	112
			48	75	76	113
			49	77	77	116
			50	78	79	117
			51	80	81	120
			52	82	82	123
			53	83	84	125
			54	85	85	128
			55	86	87	129
			56	88	89	132
			57	90	90	135
			58	91	92	136
			59	93	94	139
			60	95	95	142
			61	96	97	143
			62	98	98	146
			63	99	100	148
			64	101	102	151
			65	103	103	153
			66	104	105	155
			67	106	106	158
			68	107	108	159
			69	109	110	162
			70	111	111	165
			71	112	113	166
			72	114	115	169
			73	116	116	172
			74	117	118	174
			75	119	119	177
			76	120	121	178
			77	122	123	181
			78	124	124	184
			79	125	126	185
			80	127	127	188
			81	128	129	190	/* DEFAULT 190 cd*/
			82	130	130	193
			83	131	131	194
			84	132	132	196
			85	133	133	198
			86	134	134	199
			87	135	136	201
			88	137	137	204
			89	138	138	206
			90	139	139	208
			91	140	140	209
			92	141	141	211
			93	142	143	213
			94	144	144	216
			95	145	145	218
			96	146	146	219
			97	147	147	221
			98	148	148	223
			99	149	150	224
			100	151	151	228
			101	152	152	229
			102	153	153	231
			103	154	154	232
			104	155	155	234
			105	156	157	236
			106	158	158	239
			107	159	159	241
			108	160	160	242
			109	161	161	244
			110	162	162	246
			111	162	164	247
			112	165	165	251
			113	166	166	252
			114	167	167	254
			115	168	168	256
			116	169	169	257
			117	170	171	259
			118	172	172	262
			119	173	173	264
			120	174	172	266
			121	175	175	267
			122	176	176	269
			123	177	178	271
			124	179	179	274
			125	180	180	275
			126	181	181	277
			127	182	182	279
			128	183	183	280
			129	184	185	282
			130	186	186	285
			131	187	187	287
			132	188	188	289
			133	189	189	290
			134	190	190	292
			135	191	192	294
			136	193	193	297
			137	194	194	299
			138	198	195	300
			139	196	196	302
			140	197	197	304
			141	198	199	305
			142	200	200	309
			143	201	201	310
			144	202	202	312
			145	203	203	314
			146	204	204	315
			147	205	206	317
			148	207	207	320
			149	208	208	322
			150	209	209	323
			151	210	210	325
			152	211	211	327
			153	212	213	328
			154	214	214	332
			155	215	215	333
			156	216	216	335
			157	217	217	337
			158	218	218	338
			159	219	220	340
			160	221	221	343
			161	222	222	345
			162	223	223	347
			163	224	224	348
			164	225	225	350
			165	226	227	352
			166	228	228	355
			167	229	229	357
			168	230	230	358
			169	231	231	360
			170	232	232	361
			171	233	234	363
			172	235	235	366
			173	236	236	369
			174	237	237	370
			175	238	238	371
			176	239	239	373
			177	240	241	375
			178	242	242	378
			179	243	243	380
			180	244	244	381
			181	245	245	383
			182	246	246	385
			183	247	248	386
			184	249	249	390
			185	250	250	391
			186	251	251	393
			187	252	252	395
			188	253	253	396
			189	254	254	398
			190	255	255	400	/* MAX 400 cd*/
			230	256	256	480	/* outdoor max 480CD */
		>;
	};
};
