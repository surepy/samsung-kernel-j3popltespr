/* Copyright (c) 2013-2014, The Linux Foundation. All rights reserved.
 *
 * This program is free software; you can redistribute it and/or modify
 * it under the terms of the GNU General Public License version 2 and
 * only version 2 as published by the Free Software Foundation.
 *
 * This program is distributed in the hope that it will be useful,
 * but WITHOUT ANY WARRANTY; without even the implied warranty of
 * MERCHANTABILITY or FITNESS FOR A PARTICULAR PURPOSE.  See the
 * GNU General Public License for more details.
 */

/*---------------------------------------------------------------------------
 * This file is autogenerated file using gcdb parser. Please do not edit it.
 * Update input XML file to add a new entry or update variable in this file
 * VERSION = "1.0"
 *---------------------------------------------------------------------------*/
&mdss_mdp {
	ss_dsi_panel_S6E3FA3_AMS568MW04_FHD: ss_dsi_panel_S6E3FA3_AMS568MW04_FHD {
		qcom,mdss-dsi-panel-name = "ss_dsi_panel_S6E3FA3_AMS568MW04_FHD";
		qcom,mdss-dsi-panel-controller = <&mdss_dsi0>;
		qcom,mdss-dsi-bpp = <24>;
		qcom,mdss-dsi-panel-destination = "display_1";

		qcom,mdss-dsi-panel-width = <1080>;
		qcom,mdss-dsi-panel-height = <1920>;
		qcom,mdss-dsi-h-back-porch = <172>;
		qcom,mdss-dsi-h-front-porch = <160>;
		qcom,mdss-dsi-h-pulse-width = <12>;
		qcom,mdss-dsi-h-sync-skew = <0>;
		qcom,mdss-dsi-v-back-porch = <16>;
		qcom,mdss-dsi-v-front-porch = <8>;
		qcom,mdss-dsi-v-pulse-width = <2>;
		
		qcom,mdss-dsi-panel-framerate = <60>;
		qcom,mdss-dsi-panel-clockrate = <997000000>;
		
		qcom,mdss-dsi-panel-timings = [E6 38 26 00 68 6E 2A 46 2C 03 04 00];
		qcom,mdss-dsi-panel-timings-8996 = [
			25 1F 09 0A 06 03 04 a0
			25 1F 09 0A 06 03 04 a0
			25 1F 09 0A 06 03 04 a0
			25 1F 09 0A 06 03 04 a0
			25 1F 08 0A 06 03 04 a0];


		qcom,mdss-dsi-t-clk-pre = <0x35>;
		qcom,mdss-dsi-t-clk-post = <0x0E>;

		
		qcom,mdss-dsi-on-command= [
			05 01 00 00 14 00 02 11 00			/* Sleep out, wait 20ms(0x14) */

			/* Partial mode on */
			05 01 00 00 00 00 02 12 00

			/* Partial mode setting */
			05 01 00 00 00 00 05 30 07 7E 07 7F

			/* TE Vsync On */
			29 01 00 00 00 00 02 35 00

			/* AVC setting */
			29 01 00 00 00 00 03 FC 5A 5A		/* TEST KEY Enable */
			29 01 00 00 00 00 20 FD
			A1 20 08 04 44 00 0C 07
			00 00 FF 00 0A AA 0A AA
			0A AA 00 00 00 00 00 00
			00 00 5A 80 57 65 A8
			29 01 00 00 00 00 03 FC A5 A5

			/* PCD Setting */
			29 01 00 00 00 00 03 FC 5A 5A		/* TEST KEY Enable */
			29 01 00 00 00 00 02 CC 4C
			29 01 00 00 00 00 03 FC A5 A5

			/* ERR_FG Setting */
			29 01 00 00 00 00 03 FC 5A 5A		/* TEST KEY Enable */
			29 01 00 00 00 00 02 ED 44
			29 01 00 00 00 00 03 FC A5 A5

			/* Brightness condition set */
			29 01 00 00 00 00 03 F0 5A 5A		/* TEST KEY Enable */
			29 01 00 00 00 00 24 CA				/* 1) Gamma 2.2 Setting */
				01 00 01 00 01 00	/* V255 R,G,B */
				80 80 80			/* V203 R,G,B */
				80 80 80			/* V151 R,G,B */
				80 80 80			/* V87 R,G,B */
				80 80 80			/* V51 R,G,B */
				80 80 80			/* V35 R,G,B */
				80 80 80			/* V23 R,G,B */
				80 80 80			/* V11 R,G,B */
				80 80 80			/*  V3 R,G,B */
				00 00 00			/*  V0 R,G,B */
				00 00				/*  VT R,G,B */
			29 01 00 00 00 00 03 B2 00 14		/* AID set : AOR 0% */
			29 01 00 00 00 00 03 B6 BC 0A		/* CAPS ELVSS Set(ACL ON : 0x8C) */
			29 01 00 00 00 00 02 F7 03			/* Gamma, LTPS(AID) update */
			29 01 00 00 50 00 03 F0 A5 A5		/* TEST KEY Disable */

			/* Memory Access */
			05 01 00 00 00 00 02 2C 00
			05 01 00 00 00 00 02 3C 00
		];
				
		qcom,mdss-dsi-off-command=[
			05 01 00 00 0A 00 02 28 00	/* wait 10ms(0x0A) */
			05 01 00 00 96 00 02 10 00	/* wait 150ms(0x96) */
		];
		qcom,mdss-dsi-on-command-state = "dsi_lp_mode";
		qcom,mdss-dsi-off-command-state = "dsi_hs_mode";

		qcom,cont-splash-enabled;
		qcom,mdss-dsi-force-clk-lane-hs;
		/*qcom,cmd-sync-wait-broadcast;*/
		/*qcom,cmd-sync-wait-trigger;*/
		/*qcom,mdss-dsi-fbc-enable=*/
		/*qcom,mdss-dsi-fbc-bpp=*/
		/*qcom,mdss-dsi-fbc-packing=*/
		/*qcom,mdss-dsi-fbc-quant-error=*/
		/*qcom,mdss-dsi-fbc-bias=*/
		/*qcom,mdss-dsi-fbc-pat-mode=*/
		/*qcom,mdss-dsi-fbc-vlc-mode=*/
		/*qcom,mdss-dsi-fbc-bflc-mode=*/
		/*qcom,mdss-dsi-fbc-h-line-budget=*/
		/*qcom,mdss-dsi-fbc-budget-ctrl=*/
		/*qcom,mdss-dsi-fbc-block-budget=*/
		/*qcom,mdss-dsi-fbc-lossless-threshold=*/
		/*qcom,mdss-dsi-fbc-lossy-threshold=*/
		/*qcom,mdss-dsi-fbc-rgb-threshold=*/
		/*qcom,mdss-dsi-fbc-lossy-mode-idx=*/


		qcom,mdss-dsi-h-left-border = <0>;
		qcom,mdss-dsi-h-right-border = <0>;
		qcom,mdss-dsi-v-top-border = <0>;
		qcom,mdss-dsi-v-bottom-border = <0>;

		qcom,mdss-dsi-underflow-color = <0xFF>;
		qcom,mdss-dsi-border-color = <0>;

		/*qcom,mdss-dsi-pan-enable-dynamic-fps=*/
		/*qcom,mdss-dsi-pan-fps-update=*/

		qcom,mdss-dsi-bl-pmic-control-type = "bl_ctrl_dcs";
		/*qcom,mdss-dsi-bl-pmic-bank-select=*/
		/*qcom,mdss-dsi-bl-pmic-pwm-frequency=*/
		/*qcom,mdss-dsi-pwm-gpio=*/

		qcom,mdss-dsi-bl-min-level = <1>;
		qcom,mdss-dsi-bl-max-level = <365>;
		qcom,mdss-brightness-max-level = <365>;
		qcom,mdss-dsi-interleave-mode = <0>;
		qcom,mdss-dsi-panel-type = "dsi_cmd_mode";

		qcom,mdss-dsi-te-check-enable;
		qcom,mdss-dsi-te-using-te-pin;
		qcom,mdss-dsi-te-pin-select = <1>;

		qcom,mdss-dsi-te-dcs-command = <1>;
		qcom,mdss-dsi-wr-mem-start = <0x2C>;
		qcom,mdss-dsi-wr-mem-continue = <0x3C>;

		/* CMD mode panel doesn't need below stuff */
		qcom,mdss-dsi-h-sync-pulse= <0>;
		/*qcom,mdss-dsi-hfp-power-mode=*/
		/*qcom,mdss-dsi-hbp-power-mode=*/
		/*qcom,mdss-dsi-hsa-power-mode=*/
		/*qcom,mdss-dsi-last-line-interleave=*/
		qcom,mdss-dsi-bllp-eof-power-mode;
		qcom,mdss-dsi-bllp-power-mode;
		qcom,mdss-dsi-traffic-mode= "burst_mode";

		qcom,mdss-dsi-pixel-packing = "loose";

		qcom,mdss-dsi-virtual-channel-id = <0>;
		qcom,mdss-dsi-color-order = "rgb_swap_rgb";
		qcom,mdss-dsi-lane-0-state;
		qcom,mdss-dsi-lane-1-state;
		qcom,mdss-dsi-lane-2-state;
		qcom,mdss-dsi-lane-3-state;
		qcom,mdss-dsi-lane-map = "lane_map_0123";

		qcom,mdss-dsi-stream = <0>;
		qcom,mdss-dsi-mdp-trigger = "none";
		qcom,mdss-dsi-dma-trigger = "trigger_sw";
		
		qcom,mdss-pan-physical-width-dimension = <71>;
		qcom,mdss-pan-physical-height-dimension = <126>;

		qcom,mdss-dsi-panel-mode-gpio-state = "invalid";

		qcom,mdss-dsi-reset-sequence = <1 20>, <0 20>, <1 20>;
		// S6E3FA3(LDI) does not support Partial-update
		/*qcom,partial-update-enabled;*/
		/*qcom,panel-roi-alignment=<8 8 1 1 1 1>;*/
		/*qcom,mdss-dsi-horizontal-line-idle*/

		qcom,mdss-dsi-lp11-init;
		qcom,mdss-dsi-init-delay-us = <1000>;

		qcom,mdss-dsi-rx-eot-ignore;
		qcom,mdss-dsi-tx-eot-append;

		/*qcom,ulps-enabled*/
		/*qcom,mdss-dsi-panel-status-command=*/
		/*qcom,mdss-dsi-panel-status-command-mode="dsi_lp_mode";*/
		/*qcom,esd-check-enabled;*/
		qcom,mdss-dsi-panel-status-check-mode="reg_read_irq";
		qcom,mdss-dsi-panel-status-value = <1>;
		qcom,mdss-dsi-panel-status-irq-trigger1="rising";
		qcom,mdss-dsi-panel-status-read-length = <1>;
		/*qcom,dynamic-mode-switch-enabled*/
		/*qcom,video-to-cmd-mode-switch-commands=*/
		/*qcom,cmd-to-video-mode-switch-commands=*/
/*
 * ************************************************************************************************************************************
 *
 *
 *			Below  parameters are samsung dependent thigs
 *
 *
 * ************************************************************************************************************************************
 */
 		samsung,enter_hbm_lux = <10000>;
 		samsung,support_panel_max = <1>;
		samsung,hw-config = "single_dsi";
		samsung,support_mdnie_lite;
		samsung,panel-lpm-enable;
		//samsung,dsi-lp11-init;
		samsung,mdss-power-on-reset-delay-us = <3000>;
		/*samsung,osc-te-fitting-enable; */
		/*
		 * Index of te fitting command from
		 * "qcom,mdss-dsi-on-command" and
		 * "samsung,osc_te_fitting_tx_cmds_revA"
		 */
		samsung,osc-te-fitting-cmd-index = <16 03>;
		/* Check the duration of N-1 vsync */
		samsung,osc-te-fitting-sampling-rate = <5>;
		samsung,display_on_tx_cmds_revA = [05 01 00 00 32 00 02 29 00];
		samsung,display_on_tx_cmds_revB = [05 01 00 00 0A 00 02 29 00 05 01 00 00 00 00 02 13 00];
		samsung,display_off_tx_cmds_revA = [05 01 00 00 32 00 02 28 00];

		samsung,level1_key_enable_tx_cmds_revA = [
			29 01 00 00 00 00 03 F0 5A 5A
		];
		samsung,level1_key_disable_tx_cmds_revA = [
			29 01 00 00 00 00 03 F0 A5 A5
		];
		samsung,level2_key_enable_tx_cmds_revA = [
			29 00 00 00 00 00 03 F0 5A 5A
			29 01 00 00 00 00 03 FC 5A 5A
		];
		samsung,level2_key_disable_tx_cmds_revA = [
			29 00 00 00 00 00 03 F0 A5 A5
			29 01 00 00 00 00 03 FC A5 A5
		];

		samsung,packet_size_tx_cmds_revA = [
			37 01 00 00 00 00 02 07 00
		];

		/*
		 * First parameters can be changed
		 * by function of samsung_nv_read()
		 * because of that means offset of
		 * read position
		 */
		samsung,reg_read_pos_tx_cmds_revA = [
			15 01 00 00 00 00 02 B0 00
		];

		/*
		 * ************************************************************************************************************************
		 *	 06 01 00 00 00 00 01 c8 07 21
		 *	READ 0xC8 SIZE 0x07 OFFSET 0x21
		 * ************************************************************************************************************************
		 */
		samsung,smart_dimming_mtp_rx_cmds_revA = [ 06 01 00 00 00 00 01 c8 23 00];
		/* the last byte in all read commands will represent READ LENGH */
		samsung,manufacture_id0_rx_cmds_revA = [ 06 01 00 00 00 00 01 da 01 00];
		samsung,manufacture_id1_rx_cmds_revA = [ 06 01 00 00 00 00 01 db 01 00];
		samsung,manufacture_id2_rx_cmds_revA = [ 06 01 00 00 00 00 01 dc 01 00];

		samsung,manufacture_date_rx_cmds_revA = [ 06 01 00 00 00 00 01 c8 02 28];	/* read C8 41~42th , 40=0x28*/
		samsung,ddi_id_rx_cmds_revA = [ 06 01 00 00 00 00 01 d6 05 00];		/* read D6 1~5th */
		samsung,cell_id_rx_cmds_revA = [ 06 01 00 00 00 00 01 C8 0B 28];		/* read C8 41~51th, 40=0x28 */
		samsung,mtp_read_sysfs_rx_cmds_revA = [ 06 01 00 00 00 00 01 01 01 01];

		samsung,elvss_rx_cmds_revA = [ 06 01 00 00 00 00 01 B6 02 15];		/* read B6 22, 23th , 21=0x15*/
		samsung,mdnie_read_rx_cmds_revA	= [ 06 01 00 00 00 00 01 A1 04 00];

		samsung,ldi_debug0_rx_cmds_revA = [06 01 00 00 00 00 01 0A 01 00];
		samsung,ldi_debug1_rx_cmds_revA = [06 01 00 00 00 00 01 0E 01 00];
		samsung,ldi_debug2_rx_cmds_revA = [06 01 00 00 00 00 01 EA 08 00];

		/*
		 * ************************************************************************************************************************
		 *	 COMMON CMD LIST
		 * ************************************************************************************************************************
		 */

		samsung,elvss_lowtemp_tx_cmds_revA = [
			29 01 00 00 00 00 02 B8 19
		];	/* Low Temperature Command */

		samsung,elvss_lowtemp2_tx_cmds_revA = [
			29 01 00 00 00 00 02 B0 15
			29 01 00 00 00 00 02 B6 00
		];	/* Low Temperature Command: default */

		samsung,gamma_tx_cmds_revA = [
			29 01 00 00 00 00 24 CA	/* 1) Gamma 2.2 Setting */
				01 00 01 00 01 00	/* V255 R,G,B */
				80 80 80		/* V203 R,G,B */
				80 80 80		/* V151 R,G,B */
				80 80 80		/* V87 R,G,B */
				80 80 80		/* V51 R,G,B */
				80 80 80		/* V35 R,G,B */
				80 80 80		/* V23 R,G,B */
				80 80 80		/* V11 R,G,B */
				80 80 80		/*  V3 R,G,B */
				00 00 00		/*  V0 R,G,B */
				00 00			/*  VT R,G,B */
			29 01 00 00 00 00 02 00 00
			29 01 00 00 00 00 02 F7 03	/* Gamma, LTPS(AID) update */

			29 01 00 00 00 00 3C		/* dummy for single transmission more 100ns delay */
			00 00 00 00 00 00 00 00 00 00
			00 00 00 00 00 00 00 00 00 00
			00 00 00 00 00 00 00 00 00 00
			00 00 00 00 00 00 00 00 00 00
			00 00 00 00 00 00 00 00 00 00
			00 00 00 00 00 00 00 00 00 00

			29 01 00 00 00 00 02 F7 00
		];

		/*
		* ************************************************************************************************************************
		*  HBM
		* ************************************************************************************************************************
		*/

		samsung,hbm_rx_cmds_revA  = [ 06 01 00 00 00 00 01 B4 04 00];	/* read B4 1th~4th */
		samsung,hbm2_rx_cmds_revA = [ 06 01 00 00 00 00 01 B4 1D 04];	/* read B4 5th~33th */

		samsung,hbm_gamma_tx_cmds_revA = [
			29 01 00 00 00 00 24 CA
				01 00 01 00 01 00
				80 80 80
				80 80 80
				80 80 80
				80 80 80
				80 80 80
				80 80 80
				80 80 80
				80 80 80
				00 00 00
				00 00
			29 01 00 00 00 00 03 B2 00 14		// AID set : AOR 0%
			29 01 00 00 00 00 02 F7 03
		];

		samsung,hbm_etc_tx_cmds_revA = [		// HBM interpolation: 443~578 nit
			29 01 00 00 00 00 03 B2 00 14		// AID set : AOR 0%
			29 01 00 00 00 00 03 B6 BC 0A		// HBM ELVSS (B6h : 2nd Para)
			29 01 00 00 00 00 02 F7 03		// Gamma, LTPS(AID) update
		];

		samsung,hbm_etc2_tx_cmds_revA = [ 	/* for HBM pure mode : 600nit */
			29 01 00 00 00 00 03 B6 BC 0A		/* HBM ELVSS */
			29 01 00 00 00 00 05 B5 50 99 14 0A		/* ACL OPR 32 Frame Average start point 60% ACL 8%*/
			29 01 00 00 00 00 02 55 02		/* ACL On */
			29 01 00 00 00 00 02 53 C0		/* HBM On : elvss acl auto */
		];

		samsung,hbm_off_tx_cmds_revA = [
			29 01 00 00 00 00 02 53 00		/* HBM Off */
		];

		/*
		 * ************************************************************************************************************************
		 * AID command list and mappings
		 * ************************************************************************************************************************
		 */
		/* bl_level, Index in acl command list */
		samsung,aid_tx_cmds_revA = [
			29 01 00 00 00 00 03 B2 70 81	  /*   2 CD :  0 */
			29 01 00 00 00 00 03 B2 70 73	  /*   3 CD :  1 */
			29 01 00 00 00 00 03 B2 70 64	  /*   4 CD :  2 */
			29 01 00 00 00 00 03 B2 70 54	  /*   5 CD :  3 */
			29 01 00 00 00 00 03 B2 70 49	  /*   6 CD :  4 */
			29 01 00 00 00 00 03 B2 70 39	  /*   7 CD :  5 */
			29 01 00 00 00 00 03 B2 70 2A	  /*   8 CD :  6 */
			29 01 00 00 00 00 03 B2 70 16	  /*   9 CD :  7 */
			29 01 00 00 00 00 03 B2 70 04	  /*  10 CD :  8 */
			29 01 00 00 00 00 03 B2 60 F4	  /*  11 CD :  9 */
			29 01 00 00 00 00 03 B2 60 E3	  /*  12 CD : 10 */
			29 01 00 00 00 00 03 B2 60 D2	  /*  13 CD : 11 */
			29 01 00 00 00 00 03 B2 60 C1	  /*  14 CD : 12 */
			29 01 00 00 00 00 03 B2 60 B0	  /*  15 CD : 13 */
			29 01 00 00 00 00 03 B2 60 9E	  /*  16 CD : 14 */
			29 01 00 00 00 00 03 B2 60 85	  /*  17 CD : 15 */
			29 01 00 00 00 00 03 B2 60 62	  /*  19 CD : 16 */
			29 01 00 00 00 00 03 B2 60 50	  /*  20 CD : 17 */
			29 01 00 00 00 00 03 B2 60 40	  /*  21 CD : 18 */
			29 01 00 00 00 00 03 B2 60 2F	  /*  22 CD : 19 */
			29 01 00 00 00 00 03 B2 60 0E	  /*  24 CD : 20 */
			29 01 00 00 00 00 03 B2 50 FD	  /*  25 CD : 21 */
			29 01 00 00 00 00 03 B2 50 D4	  /*  27 CD : 22 */
			29 01 00 00 00 00 03 B2 50 B3	  /*  29 CD : 23 */
			29 01 00 00 00 00 03 B2 50 A2	  /*  30 CD : 24 */
			29 01 00 00 00 00 03 B2 50 80	  /*  32 CD : 25 */
			29 01 00 00 00 00 03 B2 50 5F	  /*  34 CD : 26 */
			29 01 00 00 00 00 03 B2 50 2E	  /*  37 CD : 27 */
			29 01 00 00 00 00 03 B2 50 05	  /*  39 CD : 28 */
			29 01 00 00 00 00 03 B2 40 E3	  /*  41 CD : 29 */
			29 01 00 00 00 00 03 B2 40 B0	  /*  44 CD : 30 */
			29 01 00 00 00 00 03 B2 40 7E	  /*  47 CD : 31 */
			29 01 00 00 00 00 03 B2 40 43	  /*  50 CD : 32 */
			29 01 00 00 00 00 03 B2 40 0F	  /*  53 CD : 33 */
			29 01 00 00 00 00 03 B2 30 D4	  /*  56 CD : 34 */
			29 01 00 00 00 00 03 B2 30 8F	  /*  60 CD : 35 */
			29 01 00 00 00 00 03 B2 30 42	  /*  64 CD : 36 */
			29 01 00 00 00 00 03 B2 20 F5	  /*  68 CD : 37 */
			29 01 00 00 00 00 03 B2 20 AE	  /*  72 CD : 38 */
			29 01 00 00 00 00 03 B2 20 A0	  /*  77 CD : 39 */
			29 01 00 00 00 00 03 B2 20 A0	  /*  82 CD : 40 */
			29 01 00 00 00 00 03 B2 20 A0	  /*  87 CD : 41 */
			29 01 00 00 00 00 03 B2 20 A0	  /*  93 CD : 42 */
			29 01 00 00 00 00 03 B2 20 A0	  /*  98 CD : 43 */
			29 01 00 00 00 00 03 B2 20 A0	  /* 105 CD : 44 */
			29 01 00 00 00 00 03 B2 20 A0	  /* 111 CD : 45 */
			29 01 00 00 00 00 03 B2 20 A0	  /* 119 CD : 46 */
			29 01 00 00 00 00 03 B2 20 A0	  /* 126 CD : 47 */
			29 01 00 00 00 00 03 B2 20 A0	  /* 134 CD : 48 */
			29 01 00 00 00 00 03 B2 20 A0	  /* 143 CD : 49 */
			29 01 00 00 00 00 03 B2 20 A0	  /* 152 CD : 50 */
			29 01 00 00 00 00 03 B2 20 A0	  /* 162 CD : 51 */
			29 01 00 00 00 00 03 B2 20 A0	  /* 172 CD : 52 */
			29 01 00 00 00 00 03 B2 20 90	  /* 183 CD : 53 */
			29 01 00 00 00 00 03 B2 20 30	  /* 195 CD : 54 */
			29 01 00 00 00 00 03 B2 10 CF	  /* 207 CD : 55 */
			29 01 00 00 00 00 03 B2 10 60	  /* 220 CD : 56 */
			29 01 00 00 00 00 03 B2 00 E6	  /* 234 CD : 57 */
			29 01 00 00 00 00 03 B2 00 CF	  /* 249 CD : 58 */
			29 01 00 00 00 00 03 B2 00 CF	  /* 265 CD : 59 */
			29 01 00 00 00 00 03 B2 00 CF	  /* 282 CD : 60 */
			29 01 00 00 00 00 03 B2 00 CF	  /* 300 CD : 61 */
			29 01 00 00 00 00 03 B2 00 CF	  /* 316 CD : 62 */
			29 01 00 00 00 00 03 B2 00 CF	  /* 333 CD : 63 */
			29 01 00 00 00 00 03 B2 00 CF	  /* 350 CD : 64 */
			29 01 00 00 00 00 03 B2 00 CF	  /* 357 CD : 65 */
			29 01 00 00 00 00 03 B2 00 CF	  /* 365 CD : 66 */
			29 01 00 00 00 00 03 B2 00 A8	  /* 372 CD : 67 */
			29 01 00 00 00 00 03 B2 00 80	  /* 380 CD : 68 */
			29 01 00 00 00 00 03 B2 00 5E	  /* 387 CD : 69 */
			29 01 00 00 00 00 03 B2 00 2A	  /* 395 CD : 70 */
			29 01 00 00 00 00 03 B2 00 14	  /* 403 CD : 71 */
			29 01 00 00 00 00 03 B2 00 14	  /* 412 CD : 72 */
			29 01 00 00 00 00 03 B2 00 14	  /* 420 CD : 73 */
		];

		samsung,aid_tx_cmds_revB = [
			29 01 00 00 00 00 03 B2 70 81	  /*   2 CD :  0 */
			29 01 00 00 00 00 03 B2 70 73	  /*   3 CD :  1 */
			29 01 00 00 00 00 03 B2 70 64	  /*   4 CD :  2 */
			29 01 00 00 00 00 03 B2 70 54	  /*   5 CD :  3 */
			29 01 00 00 00 00 03 B2 70 49	  /*   6 CD :  4 */
			29 01 00 00 00 00 03 B2 70 39	  /*   7 CD :  5 */
			29 01 00 00 00 00 03 B2 70 2A	  /*   8 CD :  6 */
			29 01 00 00 00 00 03 B2 70 16	  /*   9 CD :  7 */
			29 01 00 00 00 00 03 B2 70 04	  /*  10 CD :  8 */
			29 01 00 00 00 00 03 B2 60 F4	  /*  11 CD :  9 */
			29 01 00 00 00 00 03 B2 60 E3	  /*  12 CD : 10 */
			29 01 00 00 00 00 03 B2 60 D2	  /*  13 CD : 11 */
			29 01 00 00 00 00 03 B2 60 C2	  /*  14 CD : 12 */
			29 01 00 00 00 00 03 B2 60 B0	  /*  15 CD : 13 */
			29 01 00 00 00 00 03 B2 60 9E	  /*  16 CD : 14 */
			29 01 00 00 00 00 03 B2 60 88	  /*  17 CD : 15 */
			29 01 00 00 00 00 03 B2 60 64	  /*  19 CD : 16 */
			29 01 00 00 00 00 03 B2 60 50	  /*  20 CD : 17 */
			29 01 00 00 00 00 03 B2 60 40	  /*  21 CD : 18 */
			29 01 00 00 00 00 03 B2 60 2F	  /*  22 CD : 19 */
			29 01 00 00 00 00 03 B2 60 0E	  /*  24 CD : 20 */
			29 01 00 00 00 00 03 B2 50 FD	  /*  25 CD : 21 */
			29 01 00 00 00 00 03 B2 50 D4	  /*  27 CD : 22 */
			29 01 00 00 00 00 03 B2 50 B3	  /*  29 CD : 23 */
			29 01 00 00 00 00 03 B2 50 A2	  /*  30 CD : 24 */
			29 01 00 00 00 00 03 B2 50 80	  /*  32 CD : 25 */
			29 01 00 00 00 00 03 B2 50 5F	  /*  34 CD : 26 */
			29 01 00 00 00 00 03 B2 50 2E	  /*  37 CD : 27 */
			29 01 00 00 00 00 03 B2 50 05	  /*  39 CD : 28 */
			29 01 00 00 00 00 03 B2 40 E3	  /*  41 CD : 29 */
			29 01 00 00 00 00 03 B2 40 B0	  /*  44 CD : 30 */
			29 01 00 00 00 00 03 B2 40 7E	  /*  47 CD : 31 */
			29 01 00 00 00 00 03 B2 40 43	  /*  50 CD : 32 */
			29 01 00 00 00 00 03 B2 40 0F	  /*  53 CD : 33 */
			29 01 00 00 00 00 03 B2 30 D4	  /*  56 CD : 34 */
			29 01 00 00 00 00 03 B2 30 8F	  /*  60 CD : 35 */
			29 01 00 00 00 00 03 B2 30 42	  /*  64 CD : 36 */
			29 01 00 00 00 00 03 B2 20 F5	  /*  68 CD : 37 */
			29 01 00 00 00 00 03 B2 20 AE	  /*  72 CD : 38 */
			29 01 00 00 00 00 03 B2 20 A2	  /*  77 CD : 39 */
			29 01 00 00 00 00 03 B2 20 A2	  /*  82 CD : 40 */
			29 01 00 00 00 00 03 B2 20 A2	  /*  87 CD : 41 */
			29 01 00 00 00 00 03 B2 20 A2	  /*  93 CD : 42 */
			29 01 00 00 00 00 03 B2 20 A2	  /*  98 CD : 43 */
			29 01 00 00 00 00 03 B2 20 A2	  /* 105 CD : 44 */
			29 01 00 00 00 00 03 B2 20 A2	  /* 111 CD : 45 */
			29 01 00 00 00 00 03 B2 20 A2	  /* 119 CD : 46 */
			29 01 00 00 00 00 03 B2 20 A2	  /* 126 CD : 47 */
			29 01 00 00 00 00 03 B2 20 A2	  /* 134 CD : 48 */
			29 01 00 00 00 00 03 B2 20 A2	  /* 143 CD : 49 */
			29 01 00 00 00 00 03 B2 20 A2	  /* 152 CD : 50 */
			29 01 00 00 00 00 03 B2 20 A2	  /* 162 CD : 51 */
			29 01 00 00 00 00 03 B2 20 A2	  /* 172 CD : 52 */
			29 01 00 00 00 00 03 B2 20 9E	  /* 183 CD : 53 */
			29 01 00 00 00 00 03 B2 20 2C	  /* 195 CD : 54 */
			29 01 00 00 00 00 03 B2 10 C3	  /* 207 CD : 55 */
			29 01 00 00 00 00 03 B2 10 70	  /* 220 CD : 56 */
			29 01 00 00 00 00 03 B2 00 F0	  /* 234 CD : 57 */
			29 01 00 00 00 00 03 B2 00 CF	  /* 249 CD : 58 */
			29 01 00 00 00 00 03 B2 00 CF	  /* 265 CD : 59 */
			29 01 00 00 00 00 03 B2 00 CF	  /* 282 CD : 60 */
			29 01 00 00 00 00 03 B2 00 CF	  /* 300 CD : 61 */
			29 01 00 00 00 00 03 B2 00 CF	  /* 316 CD : 62 */
			29 01 00 00 00 00 03 B2 00 CF	  /* 333 CD : 63 */
			29 01 00 00 00 00 03 B2 00 CF	  /* 350 CD : 64 */
			29 01 00 00 00 00 03 B2 00 CF	  /* 357 CD : 65 */
			29 01 00 00 00 00 03 B2 00 CF	  /* 365 CD : 66 */
			29 01 00 00 00 00 03 B2 00 A8	  /* 372 CD : 67 */
			29 01 00 00 00 00 03 B2 00 80	  /* 380 CD : 68 */
			29 01 00 00 00 00 03 B2 00 5E	  /* 387 CD : 69 */
			29 01 00 00 00 00 03 B2 00 2A	  /* 395 CD : 70 */
			29 01 00 00 00 00 03 B2 00 14	  /* 403 CD : 71 */
			29 01 00 00 00 00 03 B2 00 14	  /* 412 CD : 72 */
			29 01 00 00 00 00 03 B2 00 14	  /* 420 CD : 73 */
		];

		samsung,aid_subdivision_tx_cmds_revA = [
			29 01 00 00 00 00 03 B2 70 7B  /*   0 */
			29 01 00 00 00 00 03 B2 70 79  /*   1 */
			29 01 00 00 00 00 03 B2 70 75  /*   2 */
			29 01 00 00 00 00 03 B2 70 73  /*   3 */
			29 01 00 00 00 00 03 B2 70 6F  /*   4 */
			29 01 00 00 00 00 03 B2 70 6D  /*   5 */
			29 01 00 00 00 00 03 B2 70 6C  /*   6 */
			29 01 00 00 00 00 03 B2 70 6B  /*   7 */
			29 01 00 00 00 00 03 B2 70 6A  /*   8 */
			29 01 00 00 00 00 03 B2 70 69  /*   9 */
			29 01 00 00 00 00 03 B2 70 62  /*  10 */
			29 01 00 00 00 00 03 B2 70 5F  /*  11 */
			29 01 00 00 00 00 03 B2 70 5E  /*  12 */
			29 01 00 00 00 00 03 B2 70 5D  /*  13 */
			29 01 00 00 00 00 03 B2 70 5C  /*  14 */
			29 01 00 00 00 00 03 B2 70 5B  /*  15 */
			29 01 00 00 00 00 03 B2 70 5A  /*  16 */
			29 01 00 00 00 00 03 B2 70 59  /*  17 */
			29 01 00 00 00 00 03 B2 70 53  /*  18 */
			29 01 00 00 00 00 03 B2 70 4F  /*  19 */
			29 01 00 00 00 00 03 B2 70 4E  /*  20 */
			29 01 00 00 00 00 03 B2 70 4D  /*  21 */
			29 01 00 00 00 00 03 B2 70 4C  /*  22 */
			29 01 00 00 00 00 03 B2 70 4B  /*  23 */
			29 01 00 00 00 00 03 B2 70 49  /*  24 */
			29 01 00 00 00 00 03 B2 70 46  /*  25 */
			29 01 00 00 00 00 03 B2 70 42  /*  26 */
			29 01 00 00 00 00 03 B2 70 3F  /*  27 */
			29 01 00 00 00 00 03 B2 70 3E  /*  28 */
			29 01 00 00 00 00 03 B2 70 3D  /*  29 */
			29 01 00 00 00 00 03 B2 70 3C  /*  30 */
			29 01 00 00 00 00 03 B2 70 3B  /*  31 */
			29 01 00 00 00 00 03 B2 70 3A  /*  32 */
			29 01 00 00 00 00 03 B2 70 3A  /*  33 */
			29 01 00 00 00 00 03 B2 70 39  /*  34 */
			29 01 00 00 00 00 03 B2 70 32  /*  35 */
			29 01 00 00 00 00 03 B2 70 2B  /*  36 */
			29 01 00 00 00 00 03 B2 70 24  /*  37 */
			29 01 00 00 00 00 03 B2 70 1C  /*  38 */
			29 01 00 00 00 00 03 B2 70 14  /*  39 */
			29 01 00 00 00 00 03 B2 70 0D  /*  40 */
			29 01 00 00 00 00 03 B2 70 0A  /*  41 */
			29 01 00 00 00 00 03 B2 70 07  /*  42 */
			29 01 00 00 00 00 03 B2 70 00  /*  43 */
			29 01 00 00 00 00 03 B2 60 F9  /*  44 */
			29 01 00 00 00 00 03 B2 60 F2  /*  45 */
			29 01 00 00 00 00 03 B2 60 EB  /*  46 */
			29 01 00 00 00 00 03 B2 60 E3  /*  47 */
			29 01 00 00 00 00 03 B2 60 DA  /*  48 */
			29 01 00 00 00 00 03 B2 60 D2  /*  49 */
			29 01 00 00 00 00 03 B2 60 CB  /*  50 */
			29 01 00 00 00 00 03 B2 60 C4  /*  51 */
			29 01 00 00 00 00 03 B2 60 BC  /*  52 */
			29 01 00 00 00 00 03 B2 60 B3  /*  53 */
			29 01 00 00 00 00 03 B2 60 AB  /*  54 */
			29 01 00 00 00 00 03 B2 60 9B  /*  55 */
			29 01 00 00 00 00 03 B2 60 8B  /*  56 */
			29 01 00 00 00 00 03 B2 60 78  /*  57 */
			29 01 00 00 00 00 03 B2 60 71  /*  58 */
			29 01 00 00 00 00 03 B2 60 69  /*  59 */
			29 01 00 00 00 00 03 B2 60 62  /*  60 */
			29 01 00 00 00 00 03 B2 60 5B  /*  61 */
			29 01 00 00 00 00 03 B2 60 4B  /*  62 */
			29 01 00 00 00 00 03 B2 60 3A  /*  63 */
			29 01 00 00 00 00 03 B2 60 33  /*  64 */
			29 01 00 00 00 00 03 B2 60 2C  /*  65 */
			29 01 00 00 00 00 03 B2 60 1D  /*  66 */
			29 01 00 00 00 00 03 B2 60 0E  /*  67 */
			29 01 00 00 00 00 03 B2 60 02  /*  68 */
			29 01 00 00 00 00 03 B2 50 F6  /*  69 */
			29 01 00 00 00 00 03 B2 50 DE  /*  70 */
			29 01 00 00 00 00 03 B2 50 D3  /*  71 */
			29 01 00 00 00 00 03 B2 50 C8  /*  72 */
			29 01 00 00 00 00 03 B2 50 BA  /*  73 */
			29 01 00 00 00 00 03 B2 50 AB  /*  74 */
			29 01 00 00 00 00 03 B2 50 95  /*  75 */
			29 01 00 00 00 00 03 B2 50 7E  /*  76 */
			29 01 00 00 00 00 03 B2 50 6E  /*  77 */
			29 01 00 00 00 00 03 B2 50 5E  /*  78 */
			29 01 00 00 00 00 03 B2 50 4D  /*  79 */
			29 01 00 00 00 00 03 B2 50 3C  /*  80 */
			29 01 00 00 00 00 03 B2 50 25  /*  81 */
			29 01 00 00 00 00 03 B2 50 0F  /*  82 */
			29 01 00 00 00 00 03 B2 40 F7  /*  83 */
			29 01 00 00 00 00 03 B2 40 DF  /*  84 */
			29 01 00 00 00 00 03 B2 40 C6  /*  85 */
			29 01 00 00 00 00 03 B2 40 AD  /*  86 */
			29 01 00 00 00 00 03 B2 40 9B  /*  87 */
			29 01 00 00 00 00 03 B2 40 8A  /*  88 */
			29 01 00 00 00 00 03 B2 40 6F  /*  89 */
			29 01 00 00 00 00 03 B2 40 54  /*  90 */
			29 01 00 00 00 00 03 B2 40 36  /*  91 */
			29 01 00 00 00 00 03 B2 40 18  /*  92 */
			29 01 00 00 00 00 03 B2 30 F7  /*  93 */
			29 01 00 00 00 00 03 B2 30 D6  /*  94 */
			29 01 00 00 00 00 03 B2 30 B6  /*  95 */
			29 01 00 00 00 00 03 B2 30 96  /*  96 */
			29 01 00 00 00 00 03 B2 30 76  /*  97 */
			29 01 00 00 00 00 03 B2 30 55  /*  98 */
			29 01 00 00 00 00 03 B2 30 64  /*  99 */
			29 01 00 00 00 00 03 B2 30 40  /* 100 */
			29 01 00 00 00 00 03 B2 30 62  /* 101 */
			29 01 00 00 00 00 03 B2 30 40  /* 102 */
			29 01 00 00 00 00 03 B2 30 60  /* 103 */
			29 01 00 00 00 00 03 B2 30 40  /* 104 */
			29 01 00 00 00 00 03 B2 30 64  /* 105 */
			29 01 00 00 00 00 03 B2 30 40  /* 106 */
			29 01 00 00 00 00 03 B2 30 5C  /* 107 */
			29 01 00 00 00 00 03 B2 30 40  /* 108 */
			29 01 00 00 00 00 03 B2 30 65  /* 109 */
			29 01 00 00 00 00 03 B2 30 40  /* 110 */
			29 01 00 00 00 00 03 B2 30 5E  /* 111 */
			29 01 00 00 00 00 03 B2 30 40  /* 112 */
			29 01 00 00 00 00 03 B2 30 65  /* 113 */
			29 01 00 00 00 00 03 B2 30 40  /* 114 */
			29 01 00 00 00 00 03 B2 30 5F  /* 115 */
			29 01 00 00 00 00 03 B2 30 40  /* 116 */
			29 01 00 00 00 00 03 B2 30 61  /* 117 */
			29 01 00 00 00 00 03 B2 30 40  /* 118 */
			29 01 00 00 00 00 03 B2 30 63  /* 119 */
			29 01 00 00 00 00 03 B2 30 40  /* 120 */
			29 01 00 00 00 00 03 B2 30 61  /* 121 */
			29 01 00 00 00 00 03 B2 30 40  /* 122 */
			29 01 00 00 00 00 03 B2 30 62  /* 123 */
			29 01 00 00 00 00 03 B2 30 40  /* 124 */
			29 01 00 00 00 00 03 B2 30 60  /* 125 */
			29 01 00 00 00 00 03 B2 30 40  /* 126 */
			29 01 00 00 00 00 03 B2 30 61  /* 127 */
			29 01 00 00 00 00 03 B2 30 40  /* 128 */
			29 01 00 00 00 00 03 B2 30 34  /* 129 */
			29 01 00 00 00 00 03 B2 30 29  /* 130 */
			29 01 00 00 00 00 03 B2 30 1D  /* 131 */
			29 01 00 00 00 00 03 B2 30 12  /* 132 */
			29 01 00 00 00 00 03 B2 30 06  /* 133 */
			29 01 00 00 00 00 03 B2 20 FB  /* 134 */
			29 01 00 00 00 00 03 B2 20 EF  /* 135 */
			29 01 00 00 00 00 03 B2 20 E3  /* 136 */
			29 01 00 00 00 00 03 B2 20 D7  /* 137 */
			29 01 00 00 00 00 03 B2 20 CB  /* 138 */
			29 01 00 00 00 00 03 B2 20 C0  /* 139 */
			29 01 00 00 00 00 03 B2 20 B4  /* 140 */
			29 01 00 00 00 00 03 B2 20 A8  /* 141 */
			29 01 00 00 00 00 03 B2 20 9C  /* 142 */
			29 01 00 00 00 00 03 B2 20 8E  /* 143 */
			29 01 00 00 00 00 03 B2 20 80  /* 144 */
			29 01 00 00 00 00 03 B2 20 72  /* 145 */
			29 01 00 00 00 00 03 B2 20 64  /* 146 */
			29 01 00 00 00 00 03 B2 20 56  /* 147 */
			29 01 00 00 00 00 03 B2 20 48  /* 148 */
			29 01 00 00 00 00 03 B2 20 3A  /* 149 */
			29 01 00 00 00 00 03 B2 20 2C  /* 150 */
			29 01 00 00 00 00 03 B2 20 1E  /* 151 */
			29 01 00 00 00 00 03 B2 20 11  /* 152 */
			29 01 00 00 00 00 03 B2 20 03  /* 153 */
			29 01 00 00 00 00 03 B2 10 F5  /* 154 */
			29 01 00 00 00 00 03 B2 10 E7  /* 155 */
			29 01 00 00 00 00 03 B2 10 DA  /* 156 */
			29 01 00 00 00 00 03 B2 10 CC  /* 157 */
			29 01 00 00 00 00 03 B2 10 E1  /* 158 */
			29 01 00 00 00 00 03 B2 10 D5  /* 159 */
			29 01 00 00 00 00 03 B2 10 CA  /* 160 */
			29 01 00 00 00 00 03 B2 10 BE  /* 161 */
			29 01 00 00 00 00 03 B2 10 B3  /* 162 */
			29 01 00 00 00 00 03 B2 10 A7  /* 163 */
			29 01 00 00 00 00 03 B2 10 9C  /* 164 */
			29 01 00 00 00 00 03 B2 10 90  /* 165 */
			29 01 00 00 00 00 03 B2 10 E2  /* 166 */
			29 01 00 00 00 00 03 B2 10 D8  /* 167 */
			29 01 00 00 00 00 03 B2 10 CE  /* 168 */
			29 01 00 00 00 00 03 B2 10 C4  /* 169 */
			29 01 00 00 00 00 03 B2 10 B9  /* 170 */
			29 01 00 00 00 00 03 B2 10 AF  /* 171 */
			29 01 00 00 00 00 03 B2 10 A5  /* 172 */
			29 01 00 00 00 00 03 B2 10 9A  /* 173 */
			29 01 00 00 00 00 03 B2 10 90  /* 174 */
			29 01 00 00 00 00 03 B2 10 E2  /* 175 */
			29 01 00 00 00 00 03 B2 10 D8  /* 176 */
			29 01 00 00 00 00 03 B2 10 CE  /* 177 */
			29 01 00 00 00 00 03 B2 10 C3  /* 178 */
			29 01 00 00 00 00 03 B2 10 B9  /* 179 */
			29 01 00 00 00 00 03 B2 10 AF  /* 180 */
			29 01 00 00 00 00 03 B2 10 A5  /* 181 */
			29 01 00 00 00 00 03 B2 10 9A  /* 182 */
			29 01 00 00 00 00 03 B2 10 90  /* 183 */
			29 01 00 00 00 00 03 B2 10 E3  /* 184 */
			29 01 00 00 00 00 03 B2 10 DA  /* 185 */
			29 01 00 00 00 00 03 B2 10 D1  /* 186 */
			29 01 00 00 00 00 03 B2 10 C7  /* 187 */
			29 01 00 00 00 00 03 B2 10 BE  /* 188 */
			29 01 00 00 00 00 03 B2 10 B5  /* 189 */
			29 01 00 00 00 00 03 B2 10 AC  /* 190 */
			29 01 00 00 00 00 03 B2 10 A2  /* 191 */
			29 01 00 00 00 00 03 B2 10 99  /* 192 */
			29 01 00 00 00 00 03 B2 10 90  /* 193 */
			29 01 00 00 00 00 03 B2 10 D4  /* 194 */
			29 01 00 00 00 00 03 B2 10 CA  /* 195 */
			29 01 00 00 00 00 03 B2 10 C1  /* 196 */
			29 01 00 00 00 00 03 B2 10 B7  /* 197 */
			29 01 00 00 00 00 03 B2 10 AD  /* 198 */
			29 01 00 00 00 00 03 B2 10 A3  /* 199 */
			29 01 00 00 00 00 03 B2 10 9A  /* 200 */
			29 01 00 00 00 00 03 B2 10 90  /* 201 */
			29 01 00 00 00 00 03 B2 10 D6  /* 202 */
			29 01 00 00 00 00 03 B2 10 CD  /* 203 */
			29 01 00 00 00 00 03 B2 10 C4  /* 204 */
			29 01 00 00 00 00 03 B2 10 BC  /* 205 */
			29 01 00 00 00 00 03 B2 10 B3  /* 206 */
			29 01 00 00 00 00 03 B2 10 AA  /* 207 */
			29 01 00 00 00 00 03 B2 10 A1  /* 208 */
			29 01 00 00 00 00 03 B2 10 99  /* 209 */
			29 01 00 00 00 00 03 B2 10 90  /* 210 */
			29 01 00 00 00 00 03 B2 10 D2  /* 211 */
			29 01 00 00 00 00 03 B2 10 CA  /* 212 */
			29 01 00 00 00 00 03 B2 10 C2  /* 213 */
			29 01 00 00 00 00 03 B2 10 B9  /* 214 */
			29 01 00 00 00 00 03 B2 10 B1  /* 215 */
			29 01 00 00 00 00 03 B2 10 A9  /* 216 */
			29 01 00 00 00 00 03 B2 10 A1  /* 217 */
			29 01 00 00 00 00 03 B2 10 98  /* 218 */
			29 01 00 00 00 00 03 B2 10 90  /* 219 */
			29 01 00 00 00 00 03 B2 10 A7  /* 220 */
			29 01 00 00 00 00 03 B2 10 9F  /* 221 */
			29 01 00 00 00 00 03 B2 10 98  /* 222 */
			29 01 00 00 00 00 03 B2 10 90  /* 223 */
			29 01 00 00 00 00 03 B2 10 A9  /* 224 */
			29 01 00 00 00 00 03 B2 10 A1  /* 225 */
			29 01 00 00 00 00 03 B2 10 98  /* 226 */
			29 01 00 00 00 00 03 B2 10 90  /* 227 */
			29 01 00 00 00 00 03 B2 10 84  /* 228 */
			29 01 00 00 00 00 03 B2 10 79  /* 229 */
			29 01 00 00 00 00 03 B2 10 6D  /* 230 */
			29 01 00 00 00 00 03 B2 10 61  /* 231 */
			29 01 00 00 00 00 03 B2 10 56  /* 232 */
			29 01 00 00 00 00 03 B2 10 4A  /* 233 */
			29 01 00 00 00 00 03 B2 10 3E  /* 234 */
			29 01 00 00 00 00 03 B2 10 36  /* 235 */
			29 01 00 00 00 00 03 B2 10 2D  /* 236 */
			29 01 00 00 00 00 03 B2 10 25  /* 237 */
			29 01 00 00 00 00 03 B2 10 1D  /* 238 */
			29 01 00 00 00 00 03 B2 10 11  /* 239 */
			29 01 00 00 00 00 03 B2 10 06  /* 240 */
			29 01 00 00 00 00 03 B2 00 FA  /* 241 */
			29 01 00 00 00 00 03 B2 00 EE  /* 242 */
			29 01 00 00 00 00 03 B2 00 DC  /* 243 */
			29 01 00 00 00 00 03 B2 00 D3  /* 244 */
			29 01 00 00 00 00 03 B2 00 CB  /* 245 */
			29 01 00 00 00 00 03 B2 00 C2  /* 246 */
			29 01 00 00 00 00 03 B2 00 DF  /* 247 */
			29 01 00 00 00 00 03 B2 00 D5  /* 248 */
			29 01 00 00 00 00 03 B2 00 CC  /* 249 */
			29 01 00 00 00 00 03 B2 00 C2  /* 250 */
			29 01 00 00 00 00 03 B2 00 DB  /* 251 */
			29 01 00 00 00 00 03 B2 00 D3  /* 252 */
			29 01 00 00 00 00 03 B2 00 CA  /* 253 */
			29 01 00 00 00 00 03 B2 00 C2  /* 254 */
			29 01 00 00 00 00 03 B2 00 C2  /* 255 */
		];

		/* bl_level, Index in acl command list */
		samsung,aid_map_table_revA = <
			2	0		3	1		4	2		5	3		6	4
			7	5		8	6		9	7		10	8		11	9
			12	10		13	11		14	12		15	13		16	14
			17	15		19	16		20	17		21	18		22	19
			24	20		25	21		27	22		29	23		30	24
			32	25		34	26		37	27		39	28		41	29
			44	30		47	31		50	32		53	33		56	34
			60	35		64	36		68	37		72	38		77	39
			82	40		87	41		93	42		98	43		105	44
			111	45		119	46		126	47		134	48		143	49
			152	50		162	51		172	52		183	53		195	54
			207	55		220	56		234	57		249	58		265	59
			282	60		300	61		316	62		333	63		350	64
			357	65		365	66		372	67		380	68		387	69
			395	70		403	71		412	72		420	73
		>;

		/*
		 * ************************************************************************************************************************
		 * ACL command list and mappings
		 * ************************************************************************************************************************
		 */
		samsung,acl_on_tx_cmds_revA = [
			29 01 00 00 00 00 05 B5 50 7F 14 14  /* 1th : 0x50 32frame avg, 2th : 0x7F start point 50%, 4th: 0x12 ACL 15% */
			29 01 00 00 00 00 02 55 02	/* ACL ON */	
		];

		samsung,acl_percent_tx_cmds_revA = [
			29 01 00 00 00 00 05 B5 50 7F 14 0A  /* 1th : 0x50 32frame avg, 2th : 0x7F start point 50%, 4th: 0x0A ACL 8% */
			29 01 00 00 00 00 05 B5 50 7F 14 14  /* 1th : 0x50 32frame avg, 2th : 0x7F start point 50%, 4th: 0x14 ACL 15% */
		];

		samsung,acl_off_tx_cmds_revA = [
			29 01 00 00 00 00 05 B5 40 7F 14 14  /* 1th : 0x50 32frame avg, 2th : 0x7F start point 50%, 4th: don't care */
			29 01 00 00 00 00 02 55 00	 /* ACL OFF */
		];

		/* bl_level , Index in acl command list */
		samsung,acl_map_table_revA =  <
			2	1		3	1		4	1		5	1		6	1
			7	1		8	1		9	1		10	1		11	1
			12	1		13	1		14	1		15	1		16	1
			17	1		19	1		20	1		21	1		22	1
			24	1		25	1		27	1		29	1		30	1
			32	1		34	1		37	1		39	1		41	1
			44	1		47	1		50	1		53	1		56	1
			60	1		64	1		68	1		72	1		77	1
			82	1		87	1		93	1		98	1		105	1
			111	1		119	1		126	1		134	1		143	1
			152	1		162	1		172	1		183	1		195	1
			207	1		220	1		234	1		249	1		265	1
			282	1		300	1		316	1		333	1		350	1
			357	1		365	1		372	1		380	1		387	1
			395	1		403	1		412	1		420	1
		>;

		/*
		 * ************************************************************************************************************************
		 * SMART ACL(ACL On) ELVSS command list and mappings
		 * ************************************************************************************************************************
		 */
		samsung,smart_acl_elvss_tx_cmds_revA = [
			29 01 00 00 00 00 03 B6 AC 0A  /*2~5 nit :  0 */
			29 01 00 00 00 00 03 B6 AC 0B  /*  6 nit :  1 */
			29 01 00 00 00 00 03 B6 AC 0C  /*  7 nit :  2 */
			29 01 00 00 00 00 03 B6 AC 0D  /*  8 nit :  3 */
			29 01 00 00 00 00 03 B6 AC 0E  /*  9 nit :  4 */
			29 01 00 00 00 00 03 B6 AC 0F  /*  10nit :  5 */
			29 01 00 00 00 00 03 B6 AC 10  /*  11 nit :  6 */
			29 01 00 00 00 00 03 B6 AC 11  /*  12 nit :  7 */
			29 01 00 00 00 00 03 B6 AC 12  /* 13 nit :  8 */
			29 01 00 00 00 00 03 B6 AC 13  /*  14 nit :  9 */
			29 01 00 00 00 00 03 B6 AC 14  /*  15 nit : 10 */
			29 01 00 00 00 00 03 B6 AC 15  /*  16 nit : 11 */
			29 01 00 00 00 00 03 B6 AC 16  /*  17 nit : 12 */
			29 01 00 00 00 00 03 B6 AC 17  /*  19 nit : 13 */
			29 01 00 00 00 00 03 B6 AC 18  /* 20~34 nit : 14 */
			29 01 00 00 00 00 03 B6 AC 17  /* 37 nit : 15 */
			29 01 00 00 00 00 03 B6 AC 17  /* 39 nit : 16 */
			29 01 00 00 00 00 03 B6 BC 17  /* 41~72 nit : 17 */
			29 01 00 00 00 00 03 B6 BC 16  /* 77 nit : 18 */
			29 01 00 00 00 00 03 B6 BC 16  /* 82 nit : 19 */
			29 01 00 00 00 00 03 B6 BC 15  /* 87~105 nit : 20 */
			29 01 00 00 00 00 03 B6 BC 14  /* 111~126 nit : 21 */
			29 01 00 00 00 00 03 B6 BC 13  /* 134~152 nit : 22 */
			29 01 00 00 00 00 03 B6 BC 12  /* 162~249 nit : 23 */
			29 01 00 00 00 00 03 B6 BC 11  /* 265 nit : 24 */
			29 01 00 00 00 00 03 B6 BC 10  /* 282 nit : 25 */
			29 01 00 00 00 00 03 B6 BC 0F  /* 300 nit : 26 */
			29 01 00 00 00 00 03 B6 BC 0E  /* 316 nit : 27 */
			29 01 00 00 00 00 03 B6 BC 0E  /* 333 nit : 28 */
			29 01 00 00 00 00 03 B6 BC 0D  /* 350 nit : 29 */
			29 01 00 00 00 00 03 B6 BC 0C  /* 357~380 : 30 */
			29 01 00 00 00 00 03 B6 BC 0B  /* 387~403 : 31 */
			29 01 00 00 00 00 03 B6 BC 0A  /* 412 nit : 32 */
			29 01 00 00 00 00 03 B6 BC 0A  /* 420 nit : 33 */
		];

		/* bl_level, Index in elvss command list */
		samsung,smart_acl_elvss_map_table_revA = <
			2	0		3	0		4	0		5	0		6	1
			7	2		8	3		9	4		10	5		11	6
			12	7		13	8		14	9		15	10		16	11
			17	12		19	13		20	14		21	14		22	14
			24	14		25	14		27	14		29	14		30	14
			32	14		34	14		37	15		39	16		41	17
			44	17		47	17		50	17		53	17		56	17
			60	17		64	17		68	17		72	17		77	18
			82	19		87	20		93	20		98	20		105	20
			111	21		119	21		126	21		134	22		143	22
			152	22		162	23		172	23		183	23		195	23
			207	23		220	23		234	23		249	23		265	24
			282	25		300	26		316	27		333	28		350	29
			357	30		365	30		372	30		380	30		387	31
			395	31		403	31		412	32		420	33
		>;

		/*
		 * ************************************************************************************************************************
		 * candela to index mappings
		 * ************************************************************************************************************************
		 */
		samsung,candela_map_table_revA = <
		/*<idx><PMSL range> <candella> *//*linear map*/
			0	0	0	2
			1	1	6	3
			2	7	13	4
			3	14	19	5
			4	20	27	6
			5	28	34	7
			6	35	36	8
			7	37	38	9
			8	39	40	10
			9	41	42	11
			10	43	44	12
			11	45	46	13
			12	47	48	14
			13	49	50	15
			14	51	52	16
			15	53	54	17
			16	55	56	19
			17	57	57	20 /* dimming*/
			18	58	59	21
			19	60	61	22
			20	62	63	24
			21	64	65	25
			22	66	67	27
			23	68	69	29
			24	70	70	30
			25	71	72	32
			26	73	74	34
			27	75	76	37
			28	77	78	39
			29	79	80	41
			30	81	82	44
			31	83	84	47
			32	85	86	50
			33	87	88	53
			34	89	90	56
			35	91	92	60
			36	93	94	64
			37	95	96	68
			38	97	98	72
			39	99	100	77
			40	101	102	82
			41	103	104	87
			42	105	106	93
			43	107	108	98
			44	109	110	105
			45	111	112	111
			46	113	114	119
			47	115	116	126
			48	117	118	134
			49	119	120	143
			50	121	122	152
			51	123	124	162
			52	125	126	172
			53	127	128	183
			54	129	135	195
			55	136	142	207
			56	143	149	220
			57	150	157	234
			58	158	165	249
			59	166	174	265
			60	175	183	282
			61	184	193	300
			62	194	201	316
			63	202	210	333
			64	211	219	350
			65	220	223	357
			66	224	227	365
			67	228	230	372
			68	231	234	380
			69	235	238	387
			70	239	242	395
			71	243	246	403
			72	247	250	412
			73	251	255	420
		>;

		samsung,hbm_candela_map_table_revA = <
			0	282	295	465	6
			1	296	309	488	7
			2	310	323	510	8
			3	324	336	533	9
			4	337	350	555	10
			5	351	364	578	11
			6	365	365	600	12
		>;

		
		samsung,panel_multires_fhd_revA = [

			/* OMOK Disable */
			29 00 00 00 00 00 03 FC 5A 5A  /* TEST KEY Enable */
			29 00 00 00 00 00 02 BA 01
			29 00 00 00 00 00 05 2A 00 00 04 37
			29 00 00 00 00 00 05 2B 00 00 07 7F
			29 01 00 00 00 00 03 FC A5 A5  /* TEST KEY Disable */


		];


		samsung,panel_multires_hd_revA = [

			/* OMOK Enable */
			29 00 00 00 00 00 03 FC 5A 5A		/* TEST KEY Enable */
			29 00 00 00 00 00 02 BA 00
			29 00 00 00 00 00 05 2A 00 00 02 CF
			29 00 00 00 00 00 05 2B 00 00 04 FF
			29 01 00 00 00 00 03 FC A5 A5		/* TEST KEY Disable */

		];

	///////////////////////////////////////////////////////////////////
	//   C7 PRO ALPM
	///////////////////////////////////////////////////////////////////

		/*
		 * The command set of R53h will be replaced with
		 * lpm 2nit or 60nit tx commnad for
		 * changing brightness level
		 */
			
		samsung,alpm_on_tx_cmds_revA = [
			29 01 00 00 00 00 03 F0 5A 5A						/* TEST KEY Enable */
			29 01 00 00 00 00 03 FC 5A 5A						/* TEST KEY Enable */
			
			29 01 00 00 00 00 02 BB 14        		/* HLPM 60nit*/			
			29 01 00 00 00 00 02 53 02							/*ALPM/HLPM 60nit On*/
			29 01 00 00 00 00 02 B0 24	                            /*global para 37th*/

			29 01 00 00 00 00 04 FD 01 01 01                          /* LTPS_EQ settings*/
			29 01 00 00 01 00 02 F7 03						     /* Gamma, LTPS(AID) update */
			29 01 00 00 00 00 08 FD A1 20 08 04 44 00 8C                              /* SRC_LOAD_EN setting */
			
			29 01 00 00 00 00 03 F0 A5 A5
			29 01 00 00 00 00 03 FC A5 A5
		];

		samsung,alpm_off_tx_cmds_revA = [
			29 01 00 00 00 00 03 F0 5A 5A		/* TEST KEY Enable */
			29 01 00 00 00 00 03 FC 5A 5A		/* TEST KEY Enable */
			05 01 00 00 14 00 02 28 00			/* display off wait 20ms */

			/* image write for normal mode */

			29 01 00 00 00 00 02 53 00			/* alpm off */
			29 01 00 00 00 00 08 FD A1 20 08 04 44 00 0C		/* SRC_LOAD_EN setting */
			29 01 00 00 00 00 03 F0 A5 A5                /* TEST KEY Disable */
			29 01 00 00 00 00 03 FC A5 A5                /* TEST KEY Disable */
		];	

		samsung,alpm_on_tx_cmds_revB = [
			29 01 00 00 00 00 03 F0 5A 5A						/* TEST KEY Enable */
			29 01 00 00 00 00 03 FC 5A 5A						/* TEST KEY Enable */
			
			29 01 00 00 00 00 02 BB 14        		/* HLPM 60nit*/			
			29 01 00 00 00 00 02 53 02							/*ALPM/HLPM 60nit On*/
			
			/* LTPS_EQ settings*/
			29 01 00 00 00 00 28 FD
			A1 20 08 04 44 00 8C
			07 00 00 FF 00 0A AA 0A
			AA 0A AA 00 00 00 00 00
			00 00 00 5A 80 57 65 A8
			95 A5 04 55 05 01 01 01
			
			29 01 00 00 01 00 02 F7 03						     /* Gamma, LTPS(AID) update */
			
			29 01 00 00 00 00 03 F0 A5 A5
			29 01 00 00 00 00 03 FC A5 A5
		];
		
		samsung,lpm_2nit_tx_cmds_revA = [29 01 00 00 14 00 02 53 03];       /* HLPM/ALPM 2nit On*/
		samsung,lpm_40nit_tx_cmds_revA = [29 01 00 00 14 00 02 53 02];		/* HLPM/ALPM 60nit On*/

		samsung,lpm_ctrl_alpm_2nit_tx_cmds_revA = [29 01 00 00 00 00 02 BB C4];
		
		samsung,lpm_ctrl_alpm_40nit_tx_cmds_revA = [29 01 00 00 00 00 02 BB 84];		
		
		samsung,lpm_ctrl_hlpm_2nit_tx_cmds_revA = [29 01 00 00 00 00 02 BB 54];	
		
		samsung,lpm_ctrl_hlpm_40nit_tx_cmds_revA = [29 01 00 00 00 00 02 BB 14];

		samsung,lpm_ctrl_alpm_aod_off_tx_cmds_revA = [
			29 01 00 00 00 00 03 F0 5A 5A	/* TEST KEY Enable */
			29 01 00 00 00 00 02 BB 00		/* AOD off */
			29 01 00 00 00 00 03 F0 A5 A5	/* TEST KEY Disable */
		];

		samsung,lpm_ctrl_alpm_aod_on_tx_cmds_revA = [
			29 01 00 00 00 00 03 F0 5A 5A	/* TEST KEY Enable */
			29 01 00 00 00 00 02 BB 01		/* AOD on */
			29 01 00 00 00 00 03 F0 A5 A5	/* TEST KEY Disable */
		];

		samsung,lpm_1hz_tx_cmds_revA = [29 01 00 00 00 00 02 00 00];
		/* 1Hz added on REV B or later version for 40nit */

		samsung,lpm_2hz_tx_cmds_revA = [29 01 00 00 00 00 02 00 00];
		/* 1Hz added on REV B or later version for 40nit */


		samsung,lpm_hz_none_tx_cmds_revA = [29 01 00 00 00 00 02 00 00];
	};
};
